/*
Written by ASAP2 Library v7.0.5
8/6/2017 12:21 PM
Original file: ASAP2Example.a2l
*/ ASAP2_VERSION 1 70
/begin PROJECT Example "Example project"
/begin HEADER "General project description" VERSION "0815" PROJECT_NO _0815 /end HEADER
/begin MODULE Module "Module \"description\" with escaped quotes"
/begin MOD_PAR "Module parameter description" VERSION "Test version 01.01.2013" SUPPLIER "jnsoft" CUSTOMER "Customer" CUSTOMER_NO "1234" USER "joe nachbaur" PHONE_NO "+49 171 1234567890" ECU "Engine control" CPU_TYPE "Intel x" EPK "EPROM identifier test" ADDR_EPK 0x0 NO_OF_INTERFACES 1
 SYSTEM_CONSTANT "CONST_PI" "3.14159"
 SYSTEM_CONSTANT "CONST_PI_2" "$(CONST_PI)/2"
 SYSTEM_CONSTANT "CONST_PI_REF_2" "$(CONST_PI_2)/2"
 SYSTEM_CONSTANT "CONST_SIN_PI_2" "sin($(CONST_PI_REF_2))"
 SYSTEM_CONSTANT "CONST_SIN_COS_PI" "1.24242 * (sin ( $(CONST_PI) ) + cos ( $(CONST_PI) ))"
 SYSTEM_CONSTANT "Simple text" "test text test"
 /begin MEMORY_SEGMENT CALIBRATIONRAM "Calibration RAM" DATA FLASH INTERN 0x0 0x8000 -1 -1 -1 -1 -1
  /begin IF_DATA XCP
   /begin SEGMENT 0x0 0x2 0x0 0x0 0x0 /begin CHECKSUM XCP_ADD_12 /end CHECKSUM
    /begin PAGE 0x0 ECU_ACCESS_WITH_XCP_ONLY XCP_READ_ACCESS_WITH_ECU_ONLY XCP_WRITE_ACCESS_NOT_ALLOWED /end PAGE
    /begin PAGE 0x1 ECU_ACCESS_WITH_XCP_ONLY XCP_READ_ACCESS_WITH_ECU_ONLY XCP_WRITE_ACCESS_WITH_ECU_ONLY /end PAGE
   /end SEGMENT
  /end IF_DATA
 /end MEMORY_SEGMENT
/end MOD_PAR
/begin IF_DATA ASAP1B_CCP
 /begin SOURCE "1 ms" 3 1 /begin QP_BLOB 1 LENGTH 10 CAN_ID_FIXED 0x710 RASTER 0 /end QP_BLOB /end SOURCE
 /begin SOURCE "10 ms" 4 1 /begin QP_BLOB 2 LENGTH 10 CAN_ID_FIXED 0x720 RASTER 1 /end QP_BLOB /end SOURCE
 /begin SOURCE "100" 5 1 /begin QP_BLOB 3 LENGTH 100 CAN_ID_FIXED 0x728 RASTER 2 /end QP_BLOB /end SOURCE
 /begin RASTER "1 ms" "1_ms" 0 3 1 /end RASTER
 /begin RASTER "10 ms" "10_ms" 1 4 1 /end RASTER
 /begin RASTER "100 ms" "100_ms" 2 5 1 /end RASTER
 /begin SEED_KEY /* seed&key dll for CAL privilege */ "" /* seed&key dll for DAQ privilege */ "" /* seed&key dll for PGM privilege */ "" /end SEED_KEY
 /begin TP_BLOB /* CCP version */ 0x201 /* Blob version */ 0x202 /* CAN msg ID - recv */ 0x7ef /* CAN msg ID - send */ 0x7ee /* station address */ 0x1234 /* byte order */ 1 BAUDRATE 1000000 DAQ_MODE BURST CONSISTENCY DAQ
  /begin CHECKSUM_PARAM /* algorithm */ 0x8001 /* M_16_BIT_BY_ADD8 */ /* limit */ 0xFFFFFFFF CHECKSUM_CALCULATION BIT_OR_WITH_OPT_PAGE /end CHECKSUM_PARAM
  /begin DEFINED_PAGES 1 "reference page" /* address ext. */ 0x00 /* base address */ 0x0 /* page length */ 0x8000 FLASH /end DEFINED_PAGES
  /begin DEFINED_PAGES 2 "working page" /* address ext. */ 0x00 /* base address */ 0x00008000 /* page length */ 0x8000 RAM FLASH_BACK RAM_INIT_BY_ECU /end DEFINED_PAGES
  OPTIONAL_CMD 0x12 /* GET_SEED */ OPTIONAL_CMD 0x13 /* UNLOCK */ OPTIONAL_CMD 0x23 /* DNLOAD_6 */ OPTIONAL_CMD 0x0F /* SHORT_UP */ OPTIONAL_CMD 0x11 /* SELECT_CAL_PAGE */ OPTIONAL_CMD 0x0C /* SET_S_STATUS */ OPTIONAL_CMD 0x0D /* GET_S_STATUS */ OPTIONAL_CMD 0x0E /* BUILD_CHKSUM */ OPTIONAL_CMD 0x10 /* CLEAR_MEMORY */ OPTIONAL_CMD 0x18 /* PROGRAM */ OPTIONAL_CMD 0x22 /* PROGRAM_6 */ OPTIONAL_CMD 0x19 /* MOVE */ OPTIONAL_CMD 0x05 /* TEST */ OPTIONAL_CMD 0x09 /* GET_ACTIVE_CAL_PAGE */ OPTIONAL_CMD 0x08 /* START_STOP_ALL */ OPTIONAL_CMD 0x20 /* DIAG_SERVICE */ /end TP_BLOB
/end IF_DATA
/begin IF_DATA XCP
 /begin PROTOCOL_LAYER 0x100 100 1000 1000 1000 1000 0 0 0xFF 0xFF BYTE_ORDER_MSB_LAST ADDRESS_GRANULARITY_BYTE OPTIONAL_CMD PROGRAM_PREPARE OPTIONAL_CMD GET_DAQ_RESOLUTION_INFO OPTIONAL_CMD GET_DAQ_PROCESSOR_INFO OPTIONAL_CMD GET_DAQ_CLOCK OPTIONAL_CMD GET_DAQ_LIST_MODE OPTIONAL_CMD WRITE_DAQ_MULTIPLE OPTIONAL_CMD COPY_CAL_PAGE OPTIONAL_CMD GET_CAL_PAGE OPTIONAL_CMD SET_CAL_PAGE OPTIONAL_CMD GET_PAG_PROCESSOR_INFO OPTIONAL_CMD SHORT_DOWNLOAD OPTIONAL_CMD DOWNLOAD_NEXT OPTIONAL_CMD DOWNLOAD_MAX OPTIONAL_CMD PROGRAM_NEXT OPTIONAL_CMD PROGRAM_MAX OPTIONAL_CMD BUILD_CHECKSUM OPTIONAL_CMD SHORT_UPLOAD OPTIONAL_CMD UPLOAD OPTIONAL_CMD SET_MTA OPTIONAL_CMD GET_SEED OPTIONAL_CMD UNLOCK OPTIONAL_CMD GET_ID COMMUNICATION_MODE_SUPPORTED BLOCK SLAVE MASTER 0x2A 0x00 /* SEED_AND_KEY_EXTERNAL_FUNCTION "C:\somewhere.dll" */ /end PROTOCOL_LAYER
 /begin DAQ DYNAMIC 0x4 0x4 0x0 OPTIMISATION_TYPE_DEFAULT ADDRESS_EXTENSION_FREE IDENTIFICATION_FIELD_TYPE_RELATIVE_BYTE GRANULARITY_ODT_ENTRY_SIZE_DAQ_BYTE 0xF8 OVERLOAD_INDICATION_PID /begin STIM GRANULARITY_ODT_ENTRY_SIZE_STIM_BYTE 0xF8 /end STIM /begin TIMESTAMP_SUPPORTED 0x1 SIZE_DWORD UNIT_10US /end TIMESTAMP_SUPPORTED
  /begin DAQ_LIST 0 DAQ_LIST_TYPE DAQ MAX_ODT 2 MAX_ODT_ENTRIES 2 EVENT_FIXED 0
   /begin PREDEFINED
    /begin ODT 0 ODT_ENTRY 0 0x4000 0x00 0x01 0xFF ODT_ENTRY 1 0x4001 0x00 0x01 0xFF /end ODT
   /end PREDEFINED
  /end DAQ_LIST
  /begin DAQ_LIST 1 DAQ_LIST_TYPE DAQ MAX_ODT 2 MAX_ODT_ENTRIES 5 EVENT_FIXED 1 /end DAQ_LIST
  /begin DAQ_LIST 2 DAQ_LIST_TYPE DAQ MAX_ODT 250 MAX_ODT_ENTRIES 255 EVENT_FIXED 2 /end DAQ_LIST
  /begin DAQ_LIST 3 DAQ_LIST_TYPE DAQ MAX_ODT 250 MAX_ODT_ENTRIES 255 EVENT_FIXED 3 /end DAQ_LIST
  /begin EVENT "100 ms" "100 ms" 0 DAQ 255 100 6 0 /end EVENT
  /begin EVENT "10 ms" "10 ms" 1 DAQ 255 10 6 0 /end EVENT
  /begin EVENT "1 ms" "1 ms" 2 DAQ 255 1 6 0 /end EVENT
  /begin EVENT "free" "free" 3 DAQ 255 0 0 0 /end EVENT
 /end DAQ
 /begin PAG 0x1 FREEZE_SUPPORTED /end PAG
 /begin PGM PGM_MODE_ABSOLUTE 0x14 0xff COMMUNICATION_MODE_SUPPORTED BLOCK SLAVE MASTER 0x2A 0x00 /begin SECTOR "Sector" 0x0 0xA0000000 0x20000 0x0 0x0 0x0 /end SECTOR /begin SECTOR "Sector" 0x1 0xA0020000 0x20000 0x0 0x0 0x0 /end SECTOR /begin SECTOR "Sector" 0x2 0xA0040000 0x40000 0x0 0x0 0x0 /end SECTOR /begin SECTOR "Sector" 0x3 0xA0080000 0x40000 0x0 0x0 0x0 /end SECTOR /begin SECTOR "Sector" 0x4 0xA00C0000 0x40000 0x0 0x0 0x0 /end SECTOR /begin SECTOR "Sector" 0x5 0xA0100000 0x40000 0x0 0x0 0x0 /end SECTOR /begin SECTOR "Sector" 0x6 0xA0140000 0x40000 0x0 0x0 0x0 /end SECTOR /begin SECTOR "Sector" 0x7 0xA0180000 0x40000 0x0 0x0 0x0 /end SECTOR /begin SECTOR "Sector" 0x8 0xA01C0000 0x40000 0x0 0x0 0x0 /end SECTOR /begin SECTOR "Sector" 0x9 0xA01C0000 0x40000 0x0 0x0 0x0 /end SECTOR /begin SECTOR "Sector" 0xA 0xA0200000 0x10000 0x0 0x0 0x0 /end SECTOR /begin SECTOR "Sector" 0xB 0xA0210000 0x10000 0x0 0x0 0x0 /end SECTOR /begin SECTOR "Sector" 0xC 0xA0220000 0x20000 0x0 0x0 0x0 /end SECTOR /begin SECTOR "Sector" 0xD 0xA0240000 0x40000 0x0 0x0 0x0 /end SECTOR /begin SECTOR "Sector" 0xE 0xA0280000 0x40000 0x0 0x0 0x0 /end SECTOR /begin SECTOR "Sector" 0xF 0xA02C0000 0x40000 0x0 0x0 0x0 /end SECTOR /begin SECTOR "Sector" 0x10 0xA0300000 0x40000 0x0 0x0 0x0 /end SECTOR /begin SECTOR "Sector" 0x11 0xA0340000 0x40000 0x0 0x0 0x0 /end SECTOR /begin SECTOR "Sector" 0x12 0xA0380000 0x40000 0x0 0x0 0x0 /end SECTOR /begin SECTOR "Sector" 0x13 0xA03C0000 0x40000 0x0 0x0 0x0 /end SECTOR /end PGM
 /begin XCP_ON_TCP_IP 0x100 1800 ADDRESS "192.168.0.2" /end XCP_ON_TCP_IP
 /begin XCP_ON_UDP_IP 0x100 21000 ADDRESS "192.168.0.2" /end XCP_ON_UDP_IP
 /begin XCP_ON_CAN 0x100 CAN_ID_MASTER 0x80000001 CAN_ID_SLAVE 0x80000002 BAUDRATE 1000000 SAMPLE_POINT 75 SAMPLE_RATE SINGLE BTL_CYCLES 8 SJW 0x2 MAX_DLC_REQUIRED SYNC_EDGE SINGLE /begin DAQ_LIST_CAN_ID 0 FIXED 0x80000310 /end DAQ_LIST_CAN_ID /begin DAQ_LIST_CAN_ID 1 FIXED 0x80000320 /end DAQ_LIST_CAN_ID /begin DAQ_LIST_CAN_ID 2 FIXED 0x80000330 /end DAQ_LIST_CAN_ID /begin DAQ_LIST_CAN_ID 3 FIXED 0x80000340 /end DAQ_LIST_CAN_ID /begin EVENT_CAN_ID_LIST 0x00 FIXED 0x00000778 /end EVENT_CAN_ID_LIST /begin EVENT_CAN_ID_LIST 0x01 FIXED 0x00000779 /end EVENT_CAN_ID_LIST /begin EVENT_CAN_ID_LIST 0x02 FIXED 0x0000077A /end EVENT_CAN_ID_LIST /begin EVENT_CAN_ID_LIST 0x03 FIXED 0x0000077B 0x077C /end EVENT_CAN_ID_LIST /*
/begin CAN_FD
MAX_DLC 64
CAN_FD_DATA_TRANSFER_BAUDRATE 4000000
MAX_DLC_REQUIRED
/end CAN_FD
*/ /end XCP_ON_CAN
 /begin XCP_ON_USB 0x100 0x108C 0xEDC 2 HEADER_LEN_FILL_WORD
  /begin OUT_EP_CMD_STIM 0x1 BULK_TRANSFER 0x40 0 MESSAGE_PACKING_SINGLE ALIGNMENT_32_BIT /end OUT_EP_CMD_STIM
  /begin IN_EP_RESERR_DAQ_EVSERV 0x1 BULK_TRANSFER 0x40 0 MESSAGE_PACKING_SINGLE ALIGNMENT_32_BIT /end IN_EP_RESERR_DAQ_EVSERV
  /begin OUT_EP_ONLY_STIM 0x2 BULK_TRANSFER 0x40 0 MESSAGE_PACKING_MULTIPLE ALIGNMENT_32_BIT /end OUT_EP_ONLY_STIM
  /begin IN_EP_ONLY_DAQ 0x2 BULK_TRANSFER 0x40 0 MESSAGE_PACKING_STREAMING ALIGNMENT_32_BIT /end IN_EP_ONLY_DAQ
  /begin IN_EP_ONLY_EVSERV 0x3 INTERRUPT_TRANSFER 0x40 16 MESSAGE_PACKING_SINGLE ALIGNMENT_32_BIT /end IN_EP_ONLY_EVSERV
  /begin DAQ_LIST_USB_ENDPOINT 0x0 /end DAQ_LIST_USB_ENDPOINT
  /begin DAQ_LIST_USB_ENDPOINT 0x1 /end DAQ_LIST_USB_ENDPOINT
  /begin DAQ_LIST_USB_ENDPOINT 0x2 /end DAQ_LIST_USB_ENDPOINT
 /end XCP_ON_USB
/end IF_DATA
/begin MOD_COMMON "Characteristic maps always deposited in same mode" BYTE_ORDER MSB_LAST DEPOSIT ABSOLUTE DATA_SIZE 16 ALIGNMENT_BYTE 1 ALIGNMENT_WORD 2 ALIGNMENT_LONG 4 ALIGNMENT_FLOAT32_IEEE 4 ALIGNMENT_FLOAT64_IEEE 4 ALIGNMENT_INT64 8 /end MOD_COMMON
/begin CHARACTERISTIC SINGLE_BIG_VALUE "SINGLE_BIG_VALUE description" VALUE 0x1004 _LONG 0 BIGVALUES 0 100000 PHYS_UNIT "m/s"
 /begin ANNOTATION ANNOTATION_ORIGIN "SINGLE_BIG_VALUE annotation origin" ANNOTATION_LABEL "SINGLE_BIG_VALUE annotation label" /begin ANNOTATION_TEXT "SINGLE_BIG_VALUE annotation text" /end ANNOTATION_TEXT /end ANNOTATION
 SYMBOL_LINK "Link_To_Variable" 0 MODEL_LINK "system/sub-system/object.name" /end CHARACTERISTIC
/begin CHARACTERISTIC SINGLE_VALUE_LINEAR "SINGLE_VALUE_LINEAR description" VALUE 0x800 _UBYTE 0 LINEAR 0 1000 /end CHARACTERISTIC
/begin CHARACTERISTIC SINGLE_VALUE "SINGLE_VALUE description" VALUE 0x1000 _LONG 0 SMALLVALUES 0.2 0.8 FORMAT "%8.4" PHYS_UNIT "m/s" EXTENDED_LIMITS 0 1 /end CHARACTERISTIC
/begin CHARACTERISTIC SINGLE_VALUE_ADAPTIVE "SINGLE_VALUE adaptive description" VALUE 0x1000 _LONG 0 SMALLVALUES 0.2 0.8 MAX_REFRESH 6 30 FORMAT "%8.4" PHYS_UNIT "m/s" READ_ONLY EXTENDED_LIMITS 0 1 /end CHARACTERISTIC
/begin CHARACTERISTIC SINGLE_VERBAL "SINGLE_VERBAL description" VALUE 0x32 _UBYTE 0 VERBAL 0 255 /end CHARACTERISTIC
/begin CHARACTERISTIC SINGLE_VERBAL_RANGE "SINGLE_VERBAL_RANGE description" VALUE 0x33 _UBYTE 0 RANGE_BYTE 0 255 /end CHARACTERISTIC
/begin CHARACTERISTIC EPKID "EEPROM identifier" ASCII 0x0 _UBYTE 0 IDENTITY 0 255 NUMBER 32 ENCODING UTF8 /end CHARACTERISTIC
/begin CHARACTERISTIC VAL_BLK_NUMERIC "VAL_BLK_NUMERIC description" VAL_BLK 0x33 _UBYTE 0 IDENTITY 0 255 NUMBER 31 /end CHARACTERISTIC
/begin CHARACTERISTIC VAL_BLK_VERBAL "VAL_BLK_VERBAL description" VAL_BLK 0x33 _UBYTE 0 VERBAL 0 255 NUMBER 31 /end CHARACTERISTIC
/begin RECORD_LAYOUT RL_DEMO_CURVE_AXIS NO_AXIS_PTS_X 1 UWORD AXIS_PTS_X 2 UWORD INDEX_INCR DIRECT /end RECORD_LAYOUT
/begin AXIS_PTS DEMO_CURVE_AXIS "DEMO_CURVE_AXIS Description" 0x300 NO_INPUT_QUANTITY RL_DEMO_CURVE_AXIS 1 IDENTITY 7 0 6553.5 DEPOSIT ABSOLUTE /end AXIS_PTS
/begin RECORD_LAYOUT RL_DEMO_CURVE_REF_AXIS FNC_VALUES 1 UWORD COLUMN_DIR DIRECT /end RECORD_LAYOUT
/begin CHARACTERISTIC DEMO_CURVE_REF_AXIS "DEMO_CURVE_REF_AXIS Description" CURVE 0x200 RL_DEMO_CURVE_REF_AXIS 1 IDENTITY 0 1000 FORMAT "%10.4"
 /begin AXIS_DESCR COM_AXIS NO_INPUT_QUANTITY IDENTITY 7 0 6553.5 AXIS_PTS_REF DEMO_CURVE_AXIS /end AXIS_DESCR
/end CHARACTERISTIC
/begin CHARACTERISTIC DEMO_CURVE "CURVE description" CURVE 0x64 CURVE_LAYOUT 0 IDENTITY 0 100 EXTENDED_LIMITS 0 255
 /begin AXIS_DESCR FIX_AXIS revolution NO_COMPU_METHOD 11 0 20000 FORMAT "%4.0" PHYS_UNIT "rpm" FIX_AXIS_PAR_DIST 0 2000 11 /end AXIS_DESCR
 /begin ANNOTATION ANNOTATION_LABEL "Calibration Note" /begin ANNOTATION_TEXT "Calibration Text" /end ANNOTATION_TEXT /end ANNOTATION
/end CHARACTERISTIC
/begin CHARACTERISTIC DEMO_MAP "MAP description" MAP 0x7C MAP_LAYOUT 0 IDENTITY 0 100 EXTENDED_LIMITS 0 255
 /begin AXIS_DESCR FIX_AXIS revolution NO_COMPU_METHOD 11 0 20000 FORMAT "%4.0" PHYS_UNIT "rpm" FIX_AXIS_PAR_DIST 0 2000 11 /end AXIS_DESCR
 /begin AXIS_DESCR FIX_AXIS speed NO_COMPU_METHOD 11 0 360 FORMAT "%8.2" PHYS_UNIT "mph" FIX_AXIS_PAR_DIST 0 36 11 /end AXIS_DESCR
 /begin ANNOTATION ANNOTATION_LABEL "Calibration Note" /begin ANNOTATION_TEXT "Calibration Text" /end ANNOTATION_TEXT /end ANNOTATION
/end CHARACTERISTIC
/*
/begin CHARACTERISTIC DEMO_CUBOID
"CUBOID description"
CUBOID
0x3000
MAP_LAYOUT
0
IDENTITY
0 100
EXTENDED_LIMITS 0 255
/begin AXIS_DESCR
FIX_AXIS
revolution
NO_COMPU_METHOD
11
0 20000
FORMAT "%4.0"
PHYS_UNIT "rpm"
FIX_AXIS_PAR_DIST 0 2000 11
/end AXIS_DESCR
/begin AXIS_DESCR
FIX_AXIS
speed
NO_COMPU_METHOD
11
0 360
FORMAT "%8.2"
PHYS_UNIT "mph"
FIX_AXIS_PAR_DIST 0 36 11
/end AXIS_DESCR
/begin AXIS_DESCR
FIX_AXIS
speed
NO_COMPU_METHOD
11
0 360
FORMAT "%8.2"
PHYS_UNIT "mph"
FIX_AXIS_PAR_DIST 0 36 11
/end AXIS_DESCR
/end CHARACTERISTIC
*/
/begin MEASUREMENT bit1_2_3 "bit1&2&3 description" UBYTE VERBAL 0 0 0 100 ECU_ADDRESS 0xC35E BIT_MASK 0x7
 /begin IF_DATA XCPplus 0x0103 /* IF_DATA XCP version */
  /begin DAQ_EVENT VARIABLE /begin AVAILABLE_EVENT_LIST EVENT 0001 EVENT 0002 /end AVAILABLE_EVENT_LIST /begin DEFAULT_EVENT_LIST EVENT 0001 /end DEFAULT_EVENT_LIST /begin CONSISTENCY_EVENT_LIST EVENT 0001 /end CONSISTENCY_EVENT_LIST /end DAQ_EVENT
 /end IF_DATA
/end MEASUREMENT
/begin MEASUREMENT byte_10_array "single byte measurement value array (10x1)
ARRAY_SIZE=10" SBYTE IDENTITY_SMALL 0 0 -1.26 1.26 ECU_ADDRESS 0xC363 MATRIX_DIM 10 1 1
 /begin IF_DATA XCPplus 0x0103 /* IF_DATA XCP version */
  /begin DAQ_EVENT FIXED_EVENT_LIST EVENT 0001 EVENT 0002 /end DAQ_EVENT
 /end IF_DATA
/end MEASUREMENT
/begin MEASUREMENT Float32_8x4_array "float measurement value array (8x4)
MATRIX_DIM = 8 4 1" FLOAT32_IEEE IDENTITY 0 0 -0.08 0.08 ECU_ADDRESS 0xC467 MATRIX_DIM 8 4 /end MEASUREMENT
/begin MEASUREMENT revolution "revolution description" SWORD IDENTITY 0 0 0 20000 PHYS_UNIT "rpm" ECU_ADDRESS 0xC350 /end MEASUREMENT
/begin MEASUREMENT speed "Measures and computes values defined by a 1:1 conversion" FLOAT32_IEEE IDENTITY 0 0 0 360 PHYS_UNIT "mph" ECU_ADDRESS 0xC352 /end MEASUREMENT
/begin MEASUREMENT speed_by_formula "Measures and computes values defined by a C-style formula" SWORD C_STYLE_FORMULA 0 0 -1000 1000 ECU_ADDRESS 0xC35B /end MEASUREMENT
/begin MEASUREMENT speed_by_interpolation "Measures and computes values defined by a data table" UBYTE INTERPOLATION 0 0 0 360 ECU_ADDRESS 0xC35A /end MEASUREMENT
/begin FUNCTION FUNC_ASCIIs "ASCII Values description" /begin DEF_CHARACTERISTIC EPKID /end DEF_CHARACTERISTIC /end FUNCTION
/begin GROUP GROUP_ASCIIs "ASCII group description" /begin REF_CHARACTERISTIC EPKID /end REF_CHARACTERISTIC /end GROUP
/begin FUNCTION FUNC_CURVEs "CURVEs description" /begin DEF_CHARACTERISTIC DEMO_CURVE /end DEF_CHARACTERISTIC /begin REF_CHARACTERISTIC DEMO_CURVE_REF_AXIS /end REF_CHARACTERISTIC /end FUNCTION
/begin FUNCTION FUNC_MAPs "MAPs description" /begin DEF_CHARACTERISTIC DEMO_MAP /end DEF_CHARACTERISTIC /end FUNCTION
/*
/begin FUNCTION FUNC_CUBOIDSs
"CUBOIDs description"
/begin DEF_CHARACTERISTIC
DEMO_CUBOID
/end DEF_CHARACTERISTIC
/end FUNCTION
*/
/begin FUNCTION FUNC_MEASUREMENTs "MEASUREMENTs description"
 /begin OUT_MEASUREMENT bit1_2_3 revolution speed_by_interpolation speed_by_formula byte_10_array Float32_8x4_array speed /end OUT_MEASUREMENT
/end FUNCTION
/begin FUNCTION FUNC_VAL_BLKs "Value Blocks description" /begin DEF_CHARACTERISTIC VAL_BLK_NUMERIC VAL_BLK_VERBAL /end DEF_CHARACTERISTIC /end FUNCTION
/begin FUNCTION FUNC_VALUESs "VALUESs description"
 /begin DEF_CHARACTERISTIC SINGLE_VALUE SINGLE_VALUE_LINEAR SINGLE_VALUE_ADAPTIVE SINGLE_BIG_VALUE SINGLE_VERBAL SINGLE_VERBAL_RANGE /end DEF_CHARACTERISTIC
/end FUNCTION
/begin COMPU_METHOD BIGVALUES "BIGVALUES description" RAT_FUNC "%8" "---" COEFFS 0 1 0 0 0 1 /end COMPU_METHOD
/begin COMPU_METHOD C_STYLE_FORMULA "Defines a C-Style formula to convert between
raw and physical values.
For simulator support, the inverse formula 
must be defined, too." FORM "%8.1" "km/h" /begin FORMULA "X*20" FORMULA_INV "X/20" /end FORMULA /end COMPU_METHOD
/begin COMPU_METHOD IDENTITY "IDENTITY description" RAT_FUNC "%4.2" "---" COEFFS 0 1 0 0 0 1 /end COMPU_METHOD
/begin COMPU_METHOD IDENTITY_SMALL "IDENTITY description" RAT_FUNC "%4.2" "---" COEFFS 0 100 0 0 0 1 /end COMPU_METHOD
/begin COMPU_METHOD INTERPOLATION "INTERPOLATION description" TAB_INTP "%8.1" "mph" COMPU_TAB_REF INTERPOLATION_TABLE_0_360 /end COMPU_METHOD
/begin COMPU_METHOD NO_INTERPOLATION "NO_INTERPOLATION description" TAB_NOINTP "%8.1" "" COMPU_TAB_REF NO_INTERPOLATION_TABLE /end COMPU_METHOD
/begin COMPU_METHOD SMALLVALUES "SMALLVALUES description" RAT_FUNC "%8.5" "---" COEFFS 0 10000 0 0 0 1 /end COMPU_METHOD
/begin COMPU_METHOD LINEAR "Linear coeffs description" LINEAR "%8.2" "mm" COEFFS_LINEAR 1.25 1 /end COMPU_METHOD
/begin COMPU_METHOD VERBAL "VERBAL description" TAB_VERB "" "" COMPU_TAB_REF VERBAL_TABLE /end COMPU_METHOD
/begin COMPU_METHOD VERBAL_BOOL "VERBAL_BOOL description" TAB_VERB "" "" COMPU_TAB_REF VERBAL_BOOL_TABLE /end COMPU_METHOD
/begin COMPU_VTAB VERBAL_BOOL_TABLE "VERBAL_BOOL_TABLE description" TAB_VERB 2 0 "FALSE" 1 "TRUE" DEFAULT_VALUE "Not set" /end COMPU_VTAB
/begin COMPU_METHOD RANGE_BYTE "RANGE_BYTE description" TAB_VERB "" "" COMPU_TAB_REF VTAB_RANGE_TABLE /end COMPU_METHOD
/begin COMPU_VTAB_RANGE VTAB_RANGE_TABLE "VTAB_RANGE_TABLE description" 2 0.0 0.9 "< 1" 1.0 255 ">= 1" DEFAULT_VALUE "Not set" /end COMPU_VTAB_RANGE
/begin COMPU_VTAB VERBAL_TABLE "VERBAL_TABLE description" TAB_VERB 7 1 "Bit1 set" 2 "Bit2 set" 3 "Bit1&2 set" 4 "Bit3 set" 5 "Bit1&3 set" 6 "Bit2&3 set" 7 "Bit1&2&3 set" DEFAULT_VALUE "Not set" /end COMPU_VTAB
/begin RECORD_LAYOUT _LONG FNC_VALUES 1 SLONG COLUMN_DIR DIRECT /end RECORD_LAYOUT
/begin RECORD_LAYOUT _UBYTE FNC_VALUES 1 UBYTE COLUMN_DIR DIRECT /end RECORD_LAYOUT
/begin RECORD_LAYOUT CURVE_LAYOUT FNC_VALUES 1 UWORD COLUMN_DIR DIRECT /end RECORD_LAYOUT
/begin RECORD_LAYOUT MAP_LAYOUT FNC_VALUES 1 SWORD COLUMN_DIR DIRECT /end RECORD_LAYOUT
/begin COMPU_TAB INTERPOLATION_TABLE_0_360 "INTERPOLATION_TABLE description" TAB_INTP 5 0 0 64 90 128 180 192 270 255 360 DEFAULT_VALUE_NUMERIC 180 /end COMPU_TAB
/begin COMPU_TAB NO_INTERPOLATION_TABLE "NO_INTERPOLATION_TABLE description" TAB_NOINTP 9 0 0 32 45 64 90 96 120 128 180 160 210 192 270 224 300 255 360 DEFAULT_VALUE_NUMERIC 180 /end COMPU_TAB
/begin UNIT metres_per_second "extended SI unit for velocity" "m/s" EXTENDED_SI SI_EXPONENTS 1 0 -1 0 0 0 0 /end UNIT
/begin UNIT kms_per_hour "derived unit for velocity: kilometres per hour" "km/h" DERIVED REF_UNIT metres_per_second UNIT_CONVERSION 3.6 0.0 /* y [km/h] = (60*60/1000) * x [m/s] + 0.0 */ /end UNIT
/begin UNIT miles_per_hour "derived unit for velocity: miles per hour" "mph" DERIVED REF_UNIT metres_per_second UNIT_CONVERSION 2.237 0.0 /* y [mph] = (60*60/1609) * x [m/s] + 0.0 */ /end UNIT
/begin VARIANT_CODING VAR_SEPARATOR "." /* PUMKF.1 */ VAR_NAMING NUMERIC /* variant criterion "Car body" with three variants */ /begin VAR_CRITERION Car "Car body" Limousine Kombi Cabrio /end VAR_CRITERION /* variant criterion "Type of gear box" with two variants */ /begin VAR_CRITERION Gear "Type of gear box" Manual Automatic /end VAR_CRITERION /begin VAR_FORBIDDEN_COMB /* forbidden: Limousine-Manual*/ Car Limousine Gear Manual /end VAR_FORBIDDEN_COMB
 /begin VAR_CHARACTERISTIC PUMKF /*define PUMKF as variant coded*/ Gear /* Gear box variants */ /begin VAR_ADDRESS 0x7140 0x7168 /end VAR_ADDRESS /end VAR_CHARACTERISTIC
 /begin VAR_CHARACTERISTIC NLLM /*define NLLM as variant coded */ Gear Car /*car body and gear box
variants*/ /begin VAR_ADDRESS 0x8840 0x8858 0x8870 0x8888 /end VAR_ADDRESS /end VAR_CHARACTERISTIC
/end VARIANT_CODING
/begin BLOB DEMO_BLOB "binary blob for FIM matrix" 0x6000 0x400 /end BLOB
/begin TYPEDEF_BLOB TD_BLOB "binary blob" 0x400 /end TYPEDEF_BLOB
/begin INSTANCE INSTANCE_BLOB "blob for FIM matrix" TD_BLOB 0x5000 /end INSTANCE
/begin TYPEDEF_CHARACTERISTIC TD_CHARACTERISTIC "" VALUE _LONG 100 NO_COMPU_METHOD -100 655 /end TYPEDEF_CHARACTERISTIC
/begin TYPEDEF_STRUCTURE TD_STRUCTURE "binary structure" 0x400 /begin STRUCTURE_COMPONENT MemberA TD_CHARACTERISTIC 0x0 /end STRUCTURE_COMPONENT /begin STRUCTURE_COMPONENT MemberB TD_CHARACTERISTIC 0x22 MATRIX_DIM 10 /end STRUCTURE_COMPONENT /end TYPEDEF_STRUCTURE
/begin TYPEDEF_MEASUREMENT TD_MEASUREMENT "register content" SWORD IDENTITY 1 0 -200 200 /end TYPEDEF_MEASUREMENT
/begin INSTANCE instance_measurement "" TD_MEASUREMENT 0x94 /begin OVERWRITE THIS 0 CONVERSION IDENTITY_SMALL /end OVERWRITE /end INSTANCE
/begin TYPEDEF_AXIS TD_AXIS "axis points for speed" revolution RL_DEMO_CURVE_AXIS 100 IDENTITY 21 0 5800 /end TYPEDEF_AXIS
/begin INSTANCE INSTANCE_AXIS "" TD_AXIS 0x4000 /end INSTANCE
/begin INSTANCE INSTANCE_CHARACTERISTIC "delay time for filtering" TD_CHARACTERISTIC 0x4080 MATRIX_DIM 5 /end INSTANCE
/begin TRANSFORMER Transformer "1.0.0.0" "transformer32.dll" "transformer64.dll" 25000 ON_USER_REQUEST TransformerReverse /begin TRANSFORMER_IN_OBJECTS DEMO_CURVE /end TRANSFORMER_IN_OBJECTS /begin TRANSFORMER_OUT_OBJECTS DEMO_BLOB /end TRANSFORMER_OUT_OBJECTS /end TRANSFORMER
/begin TRANSFORMER TransformerReverse "1.0.0.0" "TransformerReverse32.dll" "" 20000 ON_CHANGE Transformer /begin TRANSFORMER_IN_OBJECTS DEMO_BLOB /end TRANSFORMER_IN_OBJECTS /begin TRANSFORMER_OUT_OBJECTS DEMO_CURVE /end TRANSFORMER_OUT_OBJECTS /end TRANSFORMER
/end MODULE
/end PROJECT
